/*
 * Copyright (c) 2020 The ZMK Contributors
 *
 * SPDX-License-Identifier: MIT
 */

#include <behaviors.dtsi>
#include <dt-bindings/zmk/keys.h>
#include <dt-bindings/zmk/bt.h>
#include <dt-bindings/zmk/pointing.h>
#include "keys_en_gb.h"  // https://github.com/joelspadin/zmk-locale-generator/releases/tag/v1.5.0
#include "my_defines.h"

#define LCAP 1
#define LTAP 2
#define LFUN 3
#define LNAV 4

#define COMBO(NAME, TERM, KEYPOS, BINDINGS, LAYERS, PRIORIDLE) \
  combo_##NAME { \
    timeout-ms = <TERM>; \
    key-positions = <KEYPOS>; \
    bindings = <BINDINGS>; \
    layers = <LAYERS>; \
    require-prior-idle-ms = <PRIORIDLE>; \
  };

#define VCOMBO(NAME, KEYPOS, BINDINGS1, BINDINGS2) \
  COMBO(NAME, 110, KEYPOS, BINDINGS1, 0 LFUN LCAP, 0) \
  COMBO(s_##NAME, 110, KEYPOS, BINDINGS2, LTAP, 0)

#define LKEYS 0 1 2 3 4 10 11 12 13 14 20 21 22 23 24 30 31 32
#define RKEYS 5 6 7 8 9 15 16 17 18 19 25 26 27 28 29 33 34 35
#define HOMEROWMOD(KEYS) \
    compatible = "zmk,behavior-hold-tap"; \
    #binding-cells = <2>; \
    tapping-term-ms = <280>; \
    quick-tap-ms = <200>; \
    flavor = "balanced"; \
    bindings = <&kp>, <&kp>; \
    hold-trigger-key-positions = <KEYS>; \
    hold-trigger-on-release; \
    require-prior-idle-ms = <125>;


&sl {
    release-after-ms = <2000>;
    quick-release;
};

/ {
    chosen {
        zmk,physical-layout = &foostan_corne_5col_layout;
    };

    behaviors {
        hrm_li: eager_homerowmod_left {
            HOMEROWMOD(RKEYS)
            hold-while-undecided;
        };
        hrm_ri: eager_homerowmod_right {
            HOMEROWMOD(LKEYS)
            hold-while-undecided;
        };
        hrm_l: homerowmod_left {
            HOMEROWMOD(RKEYS)
        };
        hrm_r: homerowmod_right {
            HOMEROWMOD(LKEYS)
        };

        ln: linger {
            compatible = "zmk,behavior-hold-tap";
            #binding-cells = <2>;
            tapping_term_ms = <135>;
            quick_tap_ms = <0>;
            flavor = "tap-preferred";
            bindings = <&kp>, <&kp>;
        };

        semienter_caps: semienter_caps {
            compatible = "zmk,behavior-hold-tap";
            #binding-cells = <2>;
            tapping-term-ms = <280>;
            quick-tap-ms = <200>;
            flavor = "balanced";
            bindings = <&mo>, <&semienter>;
        };

        ctrl_v: ctrl_v {
            compatible = "zmk,behavior-macro";
            #binding-cells = <0>;
            wait-ms = <0>;
            tap-ms = <30>;
            // Keep the normal inter-behavior wait at zero so V and Ctrl release promptly.
            // Add a wait after pressing Ctrl, then use &none to consume that delay
            // without sending a key event. Reset the wait before macro_tap so its release
            // (and the following Ctrl release) are not delayed by the added wait.
            bindings =
                <&macro_press &kp LCTRL>,
                <&macro_wait_time 80>,
                <&none>,
                <&macro_wait_time 0>,
                <&macro_tap &kp V>,
                <&macro_release &kp LCTRL>;
        };
    };

    macros {
        double_shift: double_shift {
            compatible = "zmk,behavior-macro";
            #binding-cells = <0>;
            bindings = <&macro_tap &kp LSHFT>, <&macro_tap &kp LSHFT>;
        };

        spaces: spaces {
            compatible = "zmk,behavior-macro";
            #binding-cells = <0>;
            bindings = <&macro_tap &kp SPACE>, <&macro_tap &kp SPACE>, <&macro_tap &kp SPACE>, <&macro_tap &kp SPACE>;
        };

        semienter: semienter {
            compatible = "zmk,behavior-macro";
            #binding-cells = <0>;
            bindings = <&macro_tap &kp SEMI>, <&macro_tap &kp ENTER>;
        };

        brcs: brcs {
            compatible = "zmk,behavior-macro";
            #binding-cells = <0>;
            bindings = <&macro_tap &kp LBRC>, <&macro_tap &kp RBRC>;
        };
    };
    
    /* Key positions
      ╭─────────────────╮  ╭─────────────────╮
      |  0  1  2  3  4  |  |   5  6  7  8  9 |
      | 10 11 12 13 14  |  |  15 16 17 18 19 |
      | 20 21 22 23 24  |  |  25 26 27 28 29 |
      ╰──────╮ 30 31 32 |  | 33 34 35 ╭──────╯
             ╰──────────╯  ╰──────────╯
    */
    combos {
        compatible = "zmk,combos";

        // fix bug where sometimes not all keys register
        COMBO(all, 75, 10 11 12 13, &kp LA(LG(LC(LSHFT))), 0, 125)

        COMBO(backspace, 30, 16 17, &hrm_r RC(RSHFT) BACKSPACE, 0 LNAV LCAP LTAP, 125)
        COMBO(esc, 70, 11 12 13, &hrm_l LG(LC(LSHFT)) ESC, 0 LFUN LCAP, 0)
        COMBO(enter, 70, 16 17 18, &kp ENTER, 0 LCAP, 0)
        COMBO(win, 25, 11 12, &hrm_l LC(LWIN) LWIN, 0, 125)
        COMBO(tab, 25, 12 13, &hrm_l LC(LSHFT) TAB, 0 LFUN LCAP, 125)
        COMBO(del, 25, 2 3, &kp DEL, 0 LFUN LCAP, 125)
        COMBO(right, 50, 15 16, &kp RIGHT, 0, 125)

        COMBO(q, 25, 6 7, &kp Q, 0 LFUN, 0)
        COMBO(s_q, 25, 6 7, &kp LS(Q), LCAP LTAP, 0)
        COMBO(z, 25, 26 27, &kp Z, 0 LFUN, 0)
        COMBO(s_z, 25, 26 27, &kp LS(Z), LCAP LTAP, 0)

        COMBO(cut, 60, 21 22 23, &kp LC(X), 0, 125)
        COMBO(copy, 35, 21 22, &kp LC(C), 0, 125)
        COMBO(paste, 35, 22 23, &ctrl_v, 0, 125)

        COMBO(c_left, 110, 6 16, &kp LC(LEFT), LNAV, 0)
        COMBO(c_right, 110, 9 19, &kp LC(RIGHT), LNAV, 0)
        COMBO(bt_clear, 70, 5 6 7, &bt BT_CLR, LFUN, 0)
        COMBO(bt_sel1, 70, 6 7 8, &bt BT_SEL 0, LFUN, 0)
        COMBO(bt_sel2, 70, 7 8 9, &bt BT_SEL 1, LFUN, 0)

        VCOMBO(backtick, 0 10, _grv, _grv)
        VCOMBO(lbkt, 1 11, &kp LBKT, &kp STAR)
        VCOMBO(rbkt, 2 12, &kp RBKT, &kp EXCL)
        VCOMBO(equal, 3 13, &kp EQUAL, &kp PLUS)
        VCOMBO(pipe, 4 14, &kp GB_PIPE, &kp GB_PIPE)
        VCOMBO(ampersand, 5 15, &kp AMPS, &kp AMPS)
        VCOMBO(lpar, 6 16, &kp LPAR, &kp LT)
        VCOMBO(rpar, 7 17, &kp RPAR, &kp GT)
        VCOMBO(colon, 8 18, &kp COLON, &kp COLON)
        COMBO(num_colon, 110, 8 18, &kp COLON, LNAV, 0)

        VCOMBO(star, 11 21, &kp STAR, &kp STAR)
        VCOMBO(hash, 12 22, _hash, _pnd)
        VCOMBO(dollar, 13 23, _dlr, _eur)
        VCOMBO(percent, 14 24, &kp PRCNT, &kp PRCNT)
        VCOMBO(caret, 15 25, &kp CARET, &kp CARET)
        VCOMBO(lbrc, 16 26, &kp LBRC, &kp LBRC)
        VCOMBO(rbrc, 17 27, &kp RBRC, &kp RBRC)
        VCOMBO(semi, 18 28, &kp SEMI, &kp SEMI)

        COMBO(2shift, 50, 13 14, &double_shift, 0, 0)
    };
    
    keymap {
        compatible = "zmk,keymap";

        default_layer {
            bindings = <
                    _b    _y    _o    _u  _min          _j    _l    _d    _p    _f
                   __c   __i   __e   __a  _und          _k   __h   __t   __n   __s
                  _sqt  _dqt  _dot  _com  _fsl          _x    _m    _g    _w    _v
                              _esc __ent __spc         __r  _tap _semi
            >;
        };

        CAP {
            bindings = <
                    _B    _Y    _O    _U    __          _J    _L    _D    _P    _F
                    _C    _I   __E    _A    __          _K    _H    _T    _N    _S
                    __    __    __    __    __          _X    _M    _G    _W    _V
                                __    __    __         __R    __    __
            >;
        };

        TAP {
            bindings = <
                    _B    _Y    _O    _U   _at          _J    _L    _D    _P    _F
                    _C    _I    _E    _A   _qu          _K    _H    _T    _N    _S
                  _til  _grv   _lt   _gt  _bsl          _X    _M    _G    _W    _V
                                __ _sent    __         __R    __    __
            >;
        };

        FUN {
            bindings = <
                   _f9  _f10  _f11  _f12    __          __   _m1   _m2   _m3    __
                  __f5  __f6  __f7  __f8    __          __ _mlft  _mup  _mdn _mrgt
                   _f1   _f2   _f3   _f4    __          __ _slft  _sup  _sdn _srgt
                                __    __    __          __    __    __
            >;
        };

        NAV {
            bindings = <
                  _dot    _7    _8    _9    __          __   _hm _pgup _pgdn  _end
                   __0   __4   __5   __6    __        _ins _left   _up _down _rght
                  _com    _1    _2    _3    __          __  _vdn    __    __  _vup
                                __    __    __          __    __    __
            >;
        };
    };
};

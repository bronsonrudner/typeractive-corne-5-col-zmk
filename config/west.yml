## config/west.yml
```yaml
manifest:
  remotes:
    - name: zmkfirmware
      url-base: https://github.com/zmkfirmware
  projects:
    - name: zmk
      remote: zmkfirmware
      revision: c426d3207316f5b64457d08d4e90e8d7ad84406d
      import: app/west.yml
  self:
    path: config
```
